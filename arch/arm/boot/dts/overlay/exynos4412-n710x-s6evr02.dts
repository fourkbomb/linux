/*
 * Device tree overlay for Samsung S6EVR02 display on T0 boards
 *
 * Copyright (c) 2017 Simon Shields <simon@lineageos.org>
 *
 * This program is free software; you can redistribute it and/or modify
 * it under the terms of the GNU General Public License version 2 as
 * published by the Free Software Foundation
 */
/dts-v1/;
/plugin/;

&dsi_out {
	remote-endpoint = <&dsi_in_s6evr02>;
	status = "okay";
};

&dsi_in_s6evr02 {
	remote-endpoint = <&dsi_out>;
	status = "okay";
};

&s6evr02 {
	status = "okay";
};
