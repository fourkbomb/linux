// SPDX-License-Identifier: GPL-2.0
/dts-v1/;
#include "exynos4412-n710x.dtsi"

/ {
	compatible = "samsung,n7105", "samsung,n710x", "samsung,midas", "samsung,exynos4412", "samsung,exynos4";
	model = "Samsung Galaxy Note 2 (GT-N7105) based on Exynos4412";
};
