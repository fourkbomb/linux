// SPDX-License-Identifier: GPL-2.0
/dts-v1/;
#include "exynos4412-n710x.dtsi"

/ {
	compatible = "samsung,n7100", "samsung,n710x", "samsung,midas", "samsung,exynos4412", "samsung,exynos4";
	model = "Samsung Galaxy Note 2 (GT-N7100) based on Exynos4412";
};
